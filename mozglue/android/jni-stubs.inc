/* WARNING - This file is autogenerated by mobile/android/base/jni-generator.py. Do not edit manually! */
#ifdef JNI_STUBS

typedef void (*Java_org_mozilla_goanna_GoannaAppShell_nativeInit_t)(JNIEnv *, jclass);
static Java_org_mozilla_goanna_GoannaAppShell_nativeInit_t f_Java_org_mozilla_goanna_GoannaAppShell_nativeInit;
extern "C" NS_EXPORT void JNICALL
Java_org_mozilla_goanna_GoannaAppShell_nativeInit(JNIEnv * arg0, jclass arg1) {
    if (!f_Java_org_mozilla_goanna_GoannaAppShell_nativeInit) {
        arg0->ThrowNew(arg0->FindClass("java/lang/UnsupportedOperationException"),
                       "JNI Function called before it was loaded");
        return ;
    }
     f_Java_org_mozilla_goanna_GoannaAppShell_nativeInit(arg0, arg1);
}
#endif

#ifdef JNI_BINDINGS
  xul_dlsym("Java_org_mozilla_goanna_GoannaAppShell_nativeInit", &f_Java_org_mozilla_goanna_GoannaAppShell_nativeInit);
#endif

#ifdef JNI_STUBS

typedef void (*Java_org_mozilla_goanna_GoannaAppShell_setLayerClient_t)(JNIEnv *, jclass, jobject);
static Java_org_mozilla_goanna_GoannaAppShell_setLayerClient_t f_Java_org_mozilla_goanna_GoannaAppShell_setLayerClient;
extern "C" NS_EXPORT void JNICALL
Java_org_mozilla_goanna_GoannaAppShell_setLayerClient(JNIEnv * arg0, jclass arg1, jobject arg2) {
    if (!f_Java_org_mozilla_goanna_GoannaAppShell_setLayerClient) {
        arg0->ThrowNew(arg0->FindClass("java/lang/UnsupportedOperationException"),
                       "JNI Function called before it was loaded");
        return ;
    }
     f_Java_org_mozilla_goanna_GoannaAppShell_setLayerClient(arg0, arg1, arg2);
}
#endif

#ifdef JNI_BINDINGS
  xul_dlsym("Java_org_mozilla_goanna_GoannaAppShell_setLayerClient", &f_Java_org_mozilla_goanna_GoannaAppShell_setLayerClient);
#endif

#ifdef JNI_STUBS

typedef void (*Java_org_mozilla_goanna_GoannaAppShell_onResume_t)(JNIEnv *, jclass);
static Java_org_mozilla_goanna_GoannaAppShell_onResume_t f_Java_org_mozilla_goanna_GoannaAppShell_onResume;
extern "C" NS_EXPORT void JNICALL
Java_org_mozilla_goanna_GoannaAppShell_onResume(JNIEnv * arg0, jclass arg1) {
    if (!f_Java_org_mozilla_goanna_GoannaAppShell_onResume) {
        arg0->ThrowNew(arg0->FindClass("java/lang/UnsupportedOperationException"),
                       "JNI Function called before it was loaded");
        return ;
    }
     f_Java_org_mozilla_goanna_GoannaAppShell_onResume(arg0, arg1);
}
#endif

#ifdef JNI_BINDINGS
  xul_dlsym("Java_org_mozilla_goanna_GoannaAppShell_onResume", &f_Java_org_mozilla_goanna_GoannaAppShell_onResume);
#endif

#ifdef JNI_STUBS

typedef jobject (*Java_org_mozilla_goanna_GoannaAppShell_getNextMessageFromQueue_t)(JNIEnv *, jclass, jobject);
static Java_org_mozilla_goanna_GoannaAppShell_getNextMessageFromQueue_t f_Java_org_mozilla_goanna_GoannaAppShell_getNextMessageFromQueue;
extern "C" NS_EXPORT jobject JNICALL
Java_org_mozilla_goanna_GoannaAppShell_getNextMessageFromQueue(JNIEnv * arg0, jclass arg1, jobject arg2) {
    if (!f_Java_org_mozilla_goanna_GoannaAppShell_getNextMessageFromQueue) {
        arg0->ThrowNew(arg0->FindClass("java/lang/UnsupportedOperationException"),
                       "JNI Function called before it was loaded");
        return NULL;
    }
    return f_Java_org_mozilla_goanna_GoannaAppShell_getNextMessageFromQueue(arg0, arg1, arg2);
}
#endif

#ifdef JNI_BINDINGS
  xul_dlsym("Java_org_mozilla_goanna_GoannaAppShell_getNextMessageFromQueue", &f_Java_org_mozilla_goanna_GoannaAppShell_getNextMessageFromQueue);
#endif

#ifdef JNI_STUBS

typedef void (*Java_org_mozilla_goanna_GoannaAppShell_onSurfaceTextureFrameAvailable_t)(JNIEnv *, jclass, jobject, jint);
static Java_org_mozilla_goanna_GoannaAppShell_onSurfaceTextureFrameAvailable_t f_Java_org_mozilla_goanna_GoannaAppShell_onSurfaceTextureFrameAvailable;
extern "C" NS_EXPORT void JNICALL
Java_org_mozilla_goanna_GoannaAppShell_onSurfaceTextureFrameAvailable(JNIEnv * arg0, jclass arg1, jobject arg2, jint arg3) {
    if (!f_Java_org_mozilla_goanna_GoannaAppShell_onSurfaceTextureFrameAvailable) {
        arg0->ThrowNew(arg0->FindClass("java/lang/UnsupportedOperationException"),
                       "JNI Function called before it was loaded");
        return ;
    }
     f_Java_org_mozilla_goanna_GoannaAppShell_onSurfaceTextureFrameAvailable(arg0, arg1, arg2, arg3);
}
#endif

#ifdef JNI_BINDINGS
  xul_dlsym("Java_org_mozilla_goanna_GoannaAppShell_onSurfaceTextureFrameAvailable", &f_Java_org_mozilla_goanna_GoannaAppShell_onSurfaceTextureFrameAvailable);
#endif

#ifdef JNI_STUBS

typedef void (*Java_org_mozilla_goanna_GoannaAppShell_reportJavaCrash_t)(JNIEnv *, jclass, jstring);
static Java_org_mozilla_goanna_GoannaAppShell_reportJavaCrash_t f_Java_org_mozilla_goanna_GoannaAppShell_reportJavaCrash;
extern "C" NS_EXPORT void JNICALL
Java_org_mozilla_goanna_GoannaAppShell_reportJavaCrash(JNIEnv * arg0, jclass arg1, jstring arg2) {
    if (!f_Java_org_mozilla_goanna_GoannaAppShell_reportJavaCrash) {
        arg0->ThrowNew(arg0->FindClass("java/lang/UnsupportedOperationException"),
                       "JNI Function called before it was loaded");
        return ;
    }
     f_Java_org_mozilla_goanna_GoannaAppShell_reportJavaCrash(arg0, arg1, arg2);
}
#endif

#ifdef JNI_BINDINGS
  xul_dlsym("Java_org_mozilla_goanna_GoannaAppShell_reportJavaCrash", &f_Java_org_mozilla_goanna_GoannaAppShell_reportJavaCrash);
#endif

#ifdef JNI_STUBS

typedef void (*Java_org_mozilla_goanna_GoannaAppShell_processNextNativeEvent_t)(JNIEnv *, jclass, jboolean);
static Java_org_mozilla_goanna_GoannaAppShell_processNextNativeEvent_t f_Java_org_mozilla_goanna_GoannaAppShell_processNextNativeEvent;
extern "C" NS_EXPORT void JNICALL
Java_org_mozilla_goanna_GoannaAppShell_processNextNativeEvent(JNIEnv * arg0, jclass arg1, jboolean arg2) {
    if (!f_Java_org_mozilla_goanna_GoannaAppShell_processNextNativeEvent) {
        arg0->ThrowNew(arg0->FindClass("java/lang/UnsupportedOperationException"),
                       "JNI Function called before it was loaded");
        return ;
    }
     f_Java_org_mozilla_goanna_GoannaAppShell_processNextNativeEvent(arg0, arg1, arg2);
}
#endif

#ifdef JNI_BINDINGS
  xul_dlsym("Java_org_mozilla_goanna_GoannaAppShell_processNextNativeEvent", &f_Java_org_mozilla_goanna_GoannaAppShell_processNextNativeEvent);
#endif

#ifdef JNI_STUBS

typedef void (*Java_org_mozilla_goanna_GoannaAppShell_notifyBatteryChange_t)(JNIEnv *, jclass, jdouble, jboolean, jdouble);
static Java_org_mozilla_goanna_GoannaAppShell_notifyBatteryChange_t f_Java_org_mozilla_goanna_GoannaAppShell_notifyBatteryChange;
extern "C" NS_EXPORT void JNICALL
Java_org_mozilla_goanna_GoannaAppShell_notifyBatteryChange(JNIEnv * arg0, jclass arg1, jdouble arg2, jboolean arg3, jdouble arg4) {
    if (!f_Java_org_mozilla_goanna_GoannaAppShell_notifyBatteryChange) {
        arg0->ThrowNew(arg0->FindClass("java/lang/UnsupportedOperationException"),
                       "JNI Function called before it was loaded");
        return ;
    }
     f_Java_org_mozilla_goanna_GoannaAppShell_notifyBatteryChange(arg0, arg1, arg2, arg3, arg4);
}
#endif

#ifdef JNI_BINDINGS
  xul_dlsym("Java_org_mozilla_goanna_GoannaAppShell_notifyBatteryChange", &f_Java_org_mozilla_goanna_GoannaAppShell_notifyBatteryChange);
#endif

#ifdef JNI_STUBS

typedef void (*Java_org_mozilla_goanna_GoannaAppShell_scheduleComposite_t)(JNIEnv *, jclass);
static Java_org_mozilla_goanna_GoannaAppShell_scheduleComposite_t f_Java_org_mozilla_goanna_GoannaAppShell_scheduleComposite;
extern "C" NS_EXPORT void JNICALL
Java_org_mozilla_goanna_GoannaAppShell_scheduleComposite(JNIEnv * arg0, jclass arg1) {
    if (!f_Java_org_mozilla_goanna_GoannaAppShell_scheduleComposite) {
        arg0->ThrowNew(arg0->FindClass("java/lang/UnsupportedOperationException"),
                       "JNI Function called before it was loaded");
        return ;
    }
     f_Java_org_mozilla_goanna_GoannaAppShell_scheduleComposite(arg0, arg1);
}
#endif

#ifdef JNI_BINDINGS
  xul_dlsym("Java_org_mozilla_goanna_GoannaAppShell_scheduleComposite", &f_Java_org_mozilla_goanna_GoannaAppShell_scheduleComposite);
#endif

#ifdef JNI_STUBS

typedef void (*Java_org_mozilla_goanna_GoannaAppShell_scheduleResumeComposition_t)(JNIEnv *, jclass, jint, jint);
static Java_org_mozilla_goanna_GoannaAppShell_scheduleResumeComposition_t f_Java_org_mozilla_goanna_GoannaAppShell_scheduleResumeComposition;
extern "C" NS_EXPORT void JNICALL
Java_org_mozilla_goanna_GoannaAppShell_scheduleResumeComposition(JNIEnv * arg0, jclass arg1, jint arg2, jint arg3) {
    if (!f_Java_org_mozilla_goanna_GoannaAppShell_scheduleResumeComposition) {
        arg0->ThrowNew(arg0->FindClass("java/lang/UnsupportedOperationException"),
                       "JNI Function called before it was loaded");
        return ;
    }
     f_Java_org_mozilla_goanna_GoannaAppShell_scheduleResumeComposition(arg0, arg1, arg2, arg3);
}
#endif

#ifdef JNI_BINDINGS
  xul_dlsym("Java_org_mozilla_goanna_GoannaAppShell_scheduleResumeComposition", &f_Java_org_mozilla_goanna_GoannaAppShell_scheduleResumeComposition);
#endif

#ifdef JNI_STUBS

typedef jfloat (*Java_org_mozilla_goanna_GoannaAppShell_computeRenderIntegrity_t)(JNIEnv *, jclass);
static Java_org_mozilla_goanna_GoannaAppShell_computeRenderIntegrity_t f_Java_org_mozilla_goanna_GoannaAppShell_computeRenderIntegrity;
extern "C" NS_EXPORT jfloat JNICALL
Java_org_mozilla_goanna_GoannaAppShell_computeRenderIntegrity(JNIEnv * arg0, jclass arg1) {
    if (!f_Java_org_mozilla_goanna_GoannaAppShell_computeRenderIntegrity) {
        arg0->ThrowNew(arg0->FindClass("java/lang/UnsupportedOperationException"),
                       "JNI Function called before it was loaded");
        return 0;
    }
    return f_Java_org_mozilla_goanna_GoannaAppShell_computeRenderIntegrity(arg0, arg1);
}
#endif

#ifdef JNI_BINDINGS
  xul_dlsym("Java_org_mozilla_goanna_GoannaAppShell_computeRenderIntegrity", &f_Java_org_mozilla_goanna_GoannaAppShell_computeRenderIntegrity);
#endif

#ifdef JNI_STUBS

typedef jobject (*Java_org_mozilla_goanna_GoannaAppShell_getSurfaceBits_t)(JNIEnv *, jclass, jobject);
static Java_org_mozilla_goanna_GoannaAppShell_getSurfaceBits_t f_Java_org_mozilla_goanna_GoannaAppShell_getSurfaceBits;
extern "C" NS_EXPORT jobject JNICALL
Java_org_mozilla_goanna_GoannaAppShell_getSurfaceBits(JNIEnv * arg0, jclass arg1, jobject arg2) {
    if (!f_Java_org_mozilla_goanna_GoannaAppShell_getSurfaceBits) {
        arg0->ThrowNew(arg0->FindClass("java/lang/UnsupportedOperationException"),
                       "JNI Function called before it was loaded");
        return NULL;
    }
    return f_Java_org_mozilla_goanna_GoannaAppShell_getSurfaceBits(arg0, arg1, arg2);
}
#endif

#ifdef JNI_BINDINGS
  xul_dlsym("Java_org_mozilla_goanna_GoannaAppShell_getSurfaceBits", &f_Java_org_mozilla_goanna_GoannaAppShell_getSurfaceBits);
#endif

#ifdef JNI_STUBS

typedef void (*Java_org_mozilla_goanna_GoannaAppShell_onFullScreenPluginHidden_t)(JNIEnv *, jclass, jobject);
static Java_org_mozilla_goanna_GoannaAppShell_onFullScreenPluginHidden_t f_Java_org_mozilla_goanna_GoannaAppShell_onFullScreenPluginHidden;
extern "C" NS_EXPORT void JNICALL
Java_org_mozilla_goanna_GoannaAppShell_onFullScreenPluginHidden(JNIEnv * arg0, jclass arg1, jobject arg2) {
    if (!f_Java_org_mozilla_goanna_GoannaAppShell_onFullScreenPluginHidden) {
        arg0->ThrowNew(arg0->FindClass("java/lang/UnsupportedOperationException"),
                       "JNI Function called before it was loaded");
        return ;
    }
     f_Java_org_mozilla_goanna_GoannaAppShell_onFullScreenPluginHidden(arg0, arg1, arg2);
}
#endif

#ifdef JNI_BINDINGS
  xul_dlsym("Java_org_mozilla_goanna_GoannaAppShell_onFullScreenPluginHidden", &f_Java_org_mozilla_goanna_GoannaAppShell_onFullScreenPluginHidden);
#endif

#ifdef JNI_STUBS

typedef void (*Java_org_mozilla_goanna_GoannaAppShell_notifyGoannaOfEvent_t)(JNIEnv *, jclass, jobject);
static Java_org_mozilla_goanna_GoannaAppShell_notifyGoannaOfEvent_t f_Java_org_mozilla_goanna_GoannaAppShell_notifyGoannaOfEvent;
extern "C" NS_EXPORT void JNICALL
Java_org_mozilla_goanna_GoannaAppShell_notifyGoannaOfEvent(JNIEnv * arg0, jclass arg1, jobject arg2) {
    if (!f_Java_org_mozilla_goanna_GoannaAppShell_notifyGoannaOfEvent) {
        arg0->ThrowNew(arg0->FindClass("java/lang/UnsupportedOperationException"),
                       "JNI Function called before it was loaded");
        return ;
    }
     f_Java_org_mozilla_goanna_GoannaAppShell_notifyGoannaOfEvent(arg0, arg1, arg2);
}
#endif

#ifdef JNI_BINDINGS
  xul_dlsym("Java_org_mozilla_goanna_GoannaAppShell_notifyGoannaOfEvent", &f_Java_org_mozilla_goanna_GoannaAppShell_notifyGoannaOfEvent);
#endif

#ifdef JNI_STUBS

typedef void (*Java_org_mozilla_goanna_GoannaAppShell_cameraCallbackBridge_t)(JNIEnv *, jclass, jbyteArray);
static Java_org_mozilla_goanna_GoannaAppShell_cameraCallbackBridge_t f_Java_org_mozilla_goanna_GoannaAppShell_cameraCallbackBridge;
extern "C" NS_EXPORT void JNICALL
Java_org_mozilla_goanna_GoannaAppShell_cameraCallbackBridge(JNIEnv * arg0, jclass arg1, jbyteArray arg2) {
    if (!f_Java_org_mozilla_goanna_GoannaAppShell_cameraCallbackBridge) {
        arg0->ThrowNew(arg0->FindClass("java/lang/UnsupportedOperationException"),
                       "JNI Function called before it was loaded");
        return ;
    }
     f_Java_org_mozilla_goanna_GoannaAppShell_cameraCallbackBridge(arg0, arg1, arg2);
}
#endif

#ifdef JNI_BINDINGS
  xul_dlsym("Java_org_mozilla_goanna_GoannaAppShell_cameraCallbackBridge", &f_Java_org_mozilla_goanna_GoannaAppShell_cameraCallbackBridge);
#endif

#ifdef JNI_STUBS

typedef void (*Java_org_mozilla_goanna_GoannaAppShell_notifyFilePickerResult_t)(JNIEnv *, jclass, jstring, jlong);
static Java_org_mozilla_goanna_GoannaAppShell_notifyFilePickerResult_t f_Java_org_mozilla_goanna_GoannaAppShell_notifyFilePickerResult;
extern "C" NS_EXPORT void JNICALL
Java_org_mozilla_goanna_GoannaAppShell_notifyFilePickerResult(JNIEnv * arg0, jclass arg1, jstring arg2, jlong arg3) {
    if (!f_Java_org_mozilla_goanna_GoannaAppShell_notifyFilePickerResult) {
        arg0->ThrowNew(arg0->FindClass("java/lang/UnsupportedOperationException"),
                       "JNI Function called before it was loaded");
        return ;
    }
     f_Java_org_mozilla_goanna_GoannaAppShell_notifyFilePickerResult(arg0, arg1, arg2, arg3);
}
#endif

#ifdef JNI_BINDINGS
  xul_dlsym("Java_org_mozilla_goanna_GoannaAppShell_notifyFilePickerResult", &f_Java_org_mozilla_goanna_GoannaAppShell_notifyFilePickerResult);
#endif

#ifdef JNI_STUBS

typedef jdouble (*Java_org_mozilla_goanna_GoannaJavaSampler_getProfilerTime_t)(JNIEnv *, jclass);
static Java_org_mozilla_goanna_GoannaJavaSampler_getProfilerTime_t f_Java_org_mozilla_goanna_GoannaJavaSampler_getProfilerTime;
extern "C" NS_EXPORT jdouble JNICALL
Java_org_mozilla_goanna_GoannaJavaSampler_getProfilerTime(JNIEnv * arg0, jclass arg1) {
    if (!f_Java_org_mozilla_goanna_GoannaJavaSampler_getProfilerTime) {
        arg0->ThrowNew(arg0->FindClass("java/lang/UnsupportedOperationException"),
                       "JNI Function called before it was loaded");
        return 0;
    }
    return f_Java_org_mozilla_goanna_GoannaJavaSampler_getProfilerTime(arg0, arg1);
}
#endif

#ifdef JNI_BINDINGS
  xul_dlsym("Java_org_mozilla_goanna_GoannaJavaSampler_getProfilerTime", &f_Java_org_mozilla_goanna_GoannaJavaSampler_getProfilerTime);
#endif

#ifdef JNI_STUBS

typedef void (*Java_org_mozilla_goanna_gfx_NativePanZoomController_init_t)(JNIEnv *, jobject);
static Java_org_mozilla_goanna_gfx_NativePanZoomController_init_t f_Java_org_mozilla_goanna_gfx_NativePanZoomController_init;
extern "C" NS_EXPORT void JNICALL
Java_org_mozilla_goanna_gfx_NativePanZoomController_init(JNIEnv * arg0, jobject arg1) {
    if (!f_Java_org_mozilla_goanna_gfx_NativePanZoomController_init) {
        arg0->ThrowNew(arg0->FindClass("java/lang/UnsupportedOperationException"),
                       "JNI Function called before it was loaded");
        return ;
    }
     f_Java_org_mozilla_goanna_gfx_NativePanZoomController_init(arg0, arg1);
}
#endif

#ifdef JNI_BINDINGS
  xul_dlsym("Java_org_mozilla_goanna_gfx_NativePanZoomController_init", &f_Java_org_mozilla_goanna_gfx_NativePanZoomController_init);
#endif

#ifdef JNI_STUBS

typedef void (*Java_org_mozilla_goanna_gfx_NativePanZoomController_handleTouchEvent_t)(JNIEnv *, jobject, jobject);
static Java_org_mozilla_goanna_gfx_NativePanZoomController_handleTouchEvent_t f_Java_org_mozilla_goanna_gfx_NativePanZoomController_handleTouchEvent;
extern "C" NS_EXPORT void JNICALL
Java_org_mozilla_goanna_gfx_NativePanZoomController_handleTouchEvent(JNIEnv * arg0, jobject arg1, jobject arg2) {
    if (!f_Java_org_mozilla_goanna_gfx_NativePanZoomController_handleTouchEvent) {
        arg0->ThrowNew(arg0->FindClass("java/lang/UnsupportedOperationException"),
                       "JNI Function called before it was loaded");
        return ;
    }
     f_Java_org_mozilla_goanna_gfx_NativePanZoomController_handleTouchEvent(arg0, arg1, arg2);
}
#endif

#ifdef JNI_BINDINGS
  xul_dlsym("Java_org_mozilla_goanna_gfx_NativePanZoomController_handleTouchEvent", &f_Java_org_mozilla_goanna_gfx_NativePanZoomController_handleTouchEvent);
#endif

#ifdef JNI_STUBS

typedef void (*Java_org_mozilla_goanna_gfx_NativePanZoomController_handleMotionEvent_t)(JNIEnv *, jobject, jobject);
static Java_org_mozilla_goanna_gfx_NativePanZoomController_handleMotionEvent_t f_Java_org_mozilla_goanna_gfx_NativePanZoomController_handleMotionEvent;
extern "C" NS_EXPORT void JNICALL
Java_org_mozilla_goanna_gfx_NativePanZoomController_handleMotionEvent(JNIEnv * arg0, jobject arg1, jobject arg2) {
    if (!f_Java_org_mozilla_goanna_gfx_NativePanZoomController_handleMotionEvent) {
        arg0->ThrowNew(arg0->FindClass("java/lang/UnsupportedOperationException"),
                       "JNI Function called before it was loaded");
        return ;
    }
     f_Java_org_mozilla_goanna_gfx_NativePanZoomController_handleMotionEvent(arg0, arg1, arg2);
}
#endif

#ifdef JNI_BINDINGS
  xul_dlsym("Java_org_mozilla_goanna_gfx_NativePanZoomController_handleMotionEvent", &f_Java_org_mozilla_goanna_gfx_NativePanZoomController_handleMotionEvent);
#endif

#ifdef JNI_STUBS

typedef jlong (*Java_org_mozilla_goanna_gfx_NativePanZoomController_runDelayedCallback_t)(JNIEnv *, jobject);
static Java_org_mozilla_goanna_gfx_NativePanZoomController_runDelayedCallback_t f_Java_org_mozilla_goanna_gfx_NativePanZoomController_runDelayedCallback;
extern "C" NS_EXPORT jlong JNICALL
Java_org_mozilla_goanna_gfx_NativePanZoomController_runDelayedCallback(JNIEnv * arg0, jobject arg1) {
    if (!f_Java_org_mozilla_goanna_gfx_NativePanZoomController_runDelayedCallback) {
        arg0->ThrowNew(arg0->FindClass("java/lang/UnsupportedOperationException"),
                       "JNI Function called before it was loaded");
        return 0;
    }
    return f_Java_org_mozilla_goanna_gfx_NativePanZoomController_runDelayedCallback(arg0, arg1);
}
#endif

#ifdef JNI_BINDINGS
  xul_dlsym("Java_org_mozilla_goanna_gfx_NativePanZoomController_runDelayedCallback", &f_Java_org_mozilla_goanna_gfx_NativePanZoomController_runDelayedCallback);
#endif

#ifdef JNI_STUBS

typedef void (*Java_org_mozilla_goanna_gfx_NativePanZoomController_destroy_t)(JNIEnv *, jobject);
static Java_org_mozilla_goanna_gfx_NativePanZoomController_destroy_t f_Java_org_mozilla_goanna_gfx_NativePanZoomController_destroy;
extern "C" NS_EXPORT void JNICALL
Java_org_mozilla_goanna_gfx_NativePanZoomController_destroy(JNIEnv * arg0, jobject arg1) {
    if (!f_Java_org_mozilla_goanna_gfx_NativePanZoomController_destroy) {
        arg0->ThrowNew(arg0->FindClass("java/lang/UnsupportedOperationException"),
                       "JNI Function called before it was loaded");
        return ;
    }
     f_Java_org_mozilla_goanna_gfx_NativePanZoomController_destroy(arg0, arg1);
}
#endif

#ifdef JNI_BINDINGS
  xul_dlsym("Java_org_mozilla_goanna_gfx_NativePanZoomController_destroy", &f_Java_org_mozilla_goanna_gfx_NativePanZoomController_destroy);
#endif

#ifdef JNI_STUBS

typedef void (*Java_org_mozilla_goanna_gfx_NativePanZoomController_notifyDefaultActionPrevented_t)(JNIEnv *, jobject, jboolean);
static Java_org_mozilla_goanna_gfx_NativePanZoomController_notifyDefaultActionPrevented_t f_Java_org_mozilla_goanna_gfx_NativePanZoomController_notifyDefaultActionPrevented;
extern "C" NS_EXPORT void JNICALL
Java_org_mozilla_goanna_gfx_NativePanZoomController_notifyDefaultActionPrevented(JNIEnv * arg0, jobject arg1, jboolean arg2) {
    if (!f_Java_org_mozilla_goanna_gfx_NativePanZoomController_notifyDefaultActionPrevented) {
        arg0->ThrowNew(arg0->FindClass("java/lang/UnsupportedOperationException"),
                       "JNI Function called before it was loaded");
        return ;
    }
     f_Java_org_mozilla_goanna_gfx_NativePanZoomController_notifyDefaultActionPrevented(arg0, arg1, arg2);
}
#endif

#ifdef JNI_BINDINGS
  xul_dlsym("Java_org_mozilla_goanna_gfx_NativePanZoomController_notifyDefaultActionPrevented", &f_Java_org_mozilla_goanna_gfx_NativePanZoomController_notifyDefaultActionPrevented);
#endif

#ifdef JNI_STUBS

typedef jboolean (*Java_org_mozilla_goanna_gfx_NativePanZoomController_getRedrawHint_t)(JNIEnv *, jobject);
static Java_org_mozilla_goanna_gfx_NativePanZoomController_getRedrawHint_t f_Java_org_mozilla_goanna_gfx_NativePanZoomController_getRedrawHint;
extern "C" NS_EXPORT jboolean JNICALL
Java_org_mozilla_goanna_gfx_NativePanZoomController_getRedrawHint(JNIEnv * arg0, jobject arg1) {
    if (!f_Java_org_mozilla_goanna_gfx_NativePanZoomController_getRedrawHint) {
        arg0->ThrowNew(arg0->FindClass("java/lang/UnsupportedOperationException"),
                       "JNI Function called before it was loaded");
        return false;
    }
    return f_Java_org_mozilla_goanna_gfx_NativePanZoomController_getRedrawHint(arg0, arg1);
}
#endif

#ifdef JNI_BINDINGS
  xul_dlsym("Java_org_mozilla_goanna_gfx_NativePanZoomController_getRedrawHint", &f_Java_org_mozilla_goanna_gfx_NativePanZoomController_getRedrawHint);
#endif

#ifdef JNI_STUBS

typedef void (*Java_org_mozilla_goanna_gfx_NativePanZoomController_setOverScrollMode_t)(JNIEnv *, jobject, jint);
static Java_org_mozilla_goanna_gfx_NativePanZoomController_setOverScrollMode_t f_Java_org_mozilla_goanna_gfx_NativePanZoomController_setOverScrollMode;
extern "C" NS_EXPORT void JNICALL
Java_org_mozilla_goanna_gfx_NativePanZoomController_setOverScrollMode(JNIEnv * arg0, jobject arg1, jint arg2) {
    if (!f_Java_org_mozilla_goanna_gfx_NativePanZoomController_setOverScrollMode) {
        arg0->ThrowNew(arg0->FindClass("java/lang/UnsupportedOperationException"),
                       "JNI Function called before it was loaded");
        return ;
    }
     f_Java_org_mozilla_goanna_gfx_NativePanZoomController_setOverScrollMode(arg0, arg1, arg2);
}
#endif

#ifdef JNI_BINDINGS
  xul_dlsym("Java_org_mozilla_goanna_gfx_NativePanZoomController_setOverScrollMode", &f_Java_org_mozilla_goanna_gfx_NativePanZoomController_setOverScrollMode);
#endif

#ifdef JNI_STUBS

typedef jint (*Java_org_mozilla_goanna_gfx_NativePanZoomController_getOverScrollMode_t)(JNIEnv *, jobject);
static Java_org_mozilla_goanna_gfx_NativePanZoomController_getOverScrollMode_t f_Java_org_mozilla_goanna_gfx_NativePanZoomController_getOverScrollMode;
extern "C" NS_EXPORT jint JNICALL
Java_org_mozilla_goanna_gfx_NativePanZoomController_getOverScrollMode(JNIEnv * arg0, jobject arg1) {
    if (!f_Java_org_mozilla_goanna_gfx_NativePanZoomController_getOverScrollMode) {
        arg0->ThrowNew(arg0->FindClass("java/lang/UnsupportedOperationException"),
                       "JNI Function called before it was loaded");
        return 0;
    }
    return f_Java_org_mozilla_goanna_gfx_NativePanZoomController_getOverScrollMode(arg0, arg1);
}
#endif

#ifdef JNI_BINDINGS
  xul_dlsym("Java_org_mozilla_goanna_gfx_NativePanZoomController_getOverScrollMode", &f_Java_org_mozilla_goanna_gfx_NativePanZoomController_getOverScrollMode);
#endif

#ifdef JNI_STUBS

typedef jboolean (*Java_org_mozilla_goanna_ANRReporter_requestNativeStack_t)(JNIEnv *, jclass);
static Java_org_mozilla_goanna_ANRReporter_requestNativeStack_t f_Java_org_mozilla_goanna_ANRReporter_requestNativeStack;
extern "C" NS_EXPORT jboolean JNICALL
Java_org_mozilla_goanna_ANRReporter_requestNativeStack(JNIEnv * arg0, jclass arg1) {
    if (!f_Java_org_mozilla_goanna_ANRReporter_requestNativeStack) {
        arg0->ThrowNew(arg0->FindClass("java/lang/UnsupportedOperationException"),
                       "JNI Function called before it was loaded");
        return false;
    }
    return f_Java_org_mozilla_goanna_ANRReporter_requestNativeStack(arg0, arg1);
}
#endif

#ifdef JNI_BINDINGS
  xul_dlsym("Java_org_mozilla_goanna_ANRReporter_requestNativeStack", &f_Java_org_mozilla_goanna_ANRReporter_requestNativeStack);
#endif

#ifdef JNI_STUBS

typedef jstring (*Java_org_mozilla_goanna_ANRReporter_getNativeStack_t)(JNIEnv *, jclass);
static Java_org_mozilla_goanna_ANRReporter_getNativeStack_t f_Java_org_mozilla_goanna_ANRReporter_getNativeStack;
extern "C" NS_EXPORT jstring JNICALL
Java_org_mozilla_goanna_ANRReporter_getNativeStack(JNIEnv * arg0, jclass arg1) {
    if (!f_Java_org_mozilla_goanna_ANRReporter_getNativeStack) {
        arg0->ThrowNew(arg0->FindClass("java/lang/UnsupportedOperationException"),
                       "JNI Function called before it was loaded");
        return NULL;
    }
    return f_Java_org_mozilla_goanna_ANRReporter_getNativeStack(arg0, arg1);
}
#endif

#ifdef JNI_BINDINGS
  xul_dlsym("Java_org_mozilla_goanna_ANRReporter_getNativeStack", &f_Java_org_mozilla_goanna_ANRReporter_getNativeStack);
#endif

#ifdef JNI_STUBS

typedef void (*Java_org_mozilla_goanna_ANRReporter_releaseNativeStack_t)(JNIEnv *, jclass);
static Java_org_mozilla_goanna_ANRReporter_releaseNativeStack_t f_Java_org_mozilla_goanna_ANRReporter_releaseNativeStack;
extern "C" NS_EXPORT void JNICALL
Java_org_mozilla_goanna_ANRReporter_releaseNativeStack(JNIEnv * arg0, jclass arg1) {
    if (!f_Java_org_mozilla_goanna_ANRReporter_releaseNativeStack) {
        arg0->ThrowNew(arg0->FindClass("java/lang/UnsupportedOperationException"),
                       "JNI Function called before it was loaded");
        return ;
    }
     f_Java_org_mozilla_goanna_ANRReporter_releaseNativeStack(arg0, arg1);
}
#endif

#ifdef JNI_BINDINGS
  xul_dlsym("Java_org_mozilla_goanna_ANRReporter_releaseNativeStack", &f_Java_org_mozilla_goanna_ANRReporter_releaseNativeStack);
#endif

